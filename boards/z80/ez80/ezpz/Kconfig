## boards/z80/ez80/ezpz/Kconfig
```kconfig
#
# For a description of the syntax of this configuration file,
# see the file kconfig-language.txt in the NuttX tools repository.
#

if ARCH_BOARD_EZPZ

config EZPZ_COPYTORAM
	bool "Copy to RAM"
	default n
	depends on BOOT_RUNFROMEXTSRAM
	---help---
		This option is available only when running from external SRAM
		(CONFIG_BOOT_RUNFROMEXTSRAM).  In that case there are two possible
		options:  (1) The configuration runs entirely out of SRAM and must
		be copied into SRAM by a boot loader.  Or (2) The configuration
		boots out of FLASH, copies itself to SRAM, and runs from SRAM.  This
		configuration setting selects that latter option.

config EZPZ_SDBOOT
	bool "Build SD boot loader"
	default n
	select EZ80_BOOTLOADER
	---help---
		Select this option only with the boards/ezpz/sdboot
		configuration.  This will enable the components needed only by the
		boot loader.

endif # ARCH_BOARD_EZPZ
```
